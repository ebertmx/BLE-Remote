## prj.conf
```kconfig
CONFIG_PRINTK=y
CONFIG_COUNTER=y

CONFIG_BT=y
CONFIG_BT_BROADCASTER=y
CONFIG_BT_EXT_ADV=y
CONFIG_BT_PER_ADV=y
CONFIG_BT_DEVICE_NAME="BT_DISPLAY"

CONFIG_BT_MAX_CONN=1
CONFIG_BT_CENTRAL=y
CONFIG_BT_PER_ADV_SYNC_TRANSFER_SENDER=y

CONFIG_BT_PER_ADV_RSP=y

CONFIG_BT_REMOTE_INFO=y
CONFIG_BT_GATT_CLIENT=y

CONFIG_LOG=y

CONFIG_USB_DEVICE_STACK=y
CONFIG_USB_DEVICE_PRODUCT="DISPLAY_USB"
CONFIG_USB_DEVICE_PID=0x0004
CONFIG_USB_DEVICE_INITIALIZE_AT_BOOT=n

CONFIG_SERIAL=y
CONFIG_CONSOLE=y
CONFIG_UART_CONSOLE=y
CONFIG_UART_LINE_CTRL=y

CONFIG_SYS_CLOCK_TICKS_PER_SEC=128
```

## src/main.c
```c
/*
 * Copyright (c) 2023 Nordic Semiconductor ASA
 *
 * SPDX-License-Identifier: Apache-2.0
 */

#include <zephyr/bluetooth/bluetooth.h>
#include <zephyr/bluetooth/conn.h>
#include <zephyr/bluetooth/gatt.h>
#include <zephyr/bluetooth/uuid.h>
#include <zephyr/sys/util.h>
#include "d_UART_helper.c"
#include "d_BT_helper.c"

K_SEM_DEFINE(acking, 0, 1);
uint8_t dev_data[] = {'D', 'I', 'S', '0', '1', 'x', 9};

static uint8_t conn_dev[] = {'R', 'E', 'M', '0', '1', 'x'};

uint8_t S_CONN_DEV = sizeof(conn_dev);

struct bt_data adv_data[] = {
	BT_DATA(BT_DATA_MANUFACTURER_DATA, dev_data, 7)};
volatile uint8_t count;

int main(void)
{
	uart_init();
	bluetooth_init();
	start_scan();
	while (1)
	{

		//k_sem_take(&acking, K_FOREVER);
		//stop_adv();
		//dev_data[6] = count;
		//start_adv(&adv_data);
		k_sleep(K_MSEC(100));
	}

	return 0;
}

void scan_cb(const bt_addr_le_t *addr, int8_t rssi, uint8_t adv_type,
			 struct net_buf_simple *buf)
{

	if (k_sem_count_get(&acking) != 0)
	{
		return;
	}
	bool read_dev = false;
	int i = 0;

	// check for DIS device
	for (i = 0; i < buf->len; i++)
	{
		// iterate through device name
		if (buf->data[i] == conn_dev[0])
		{
			read_dev = true;
			break;
		}
	}
	if (read_dev == false)
	{
		// device is NOT a REM
		return;
	}

	char device[6];
	int k = 0;

	// Confirm device REM
	while (k < S_CONN_DEV)
	{
		if (buf->data[i] == conn_dev[k])
		{
			device[k] = buf->data[i];
			i++;
			k++;
		}
		else
		{
			read_dev = false;
			// device is not a DIS
			return;
		}
	}
	// device is a DIS
	if (read_dev)
	{

		if (buf->data[i] != count)
		{
			printk("(REMOTE):");
			printk(" dev = %s  ", device);
			printk(" count = %d\n", buf->data[i]);
			count = buf->data[i];
			k_sem_give(&acking);
		}
	}
	else
	{
		return;
	}
	// ACK reciept of count to REM device
}
```

## src/d_BT_helper.c
```c
/* main.c - Application main entry point */

/*
 * Copyright (c) 2015-2016 Intel Corporation
 *
 * SPDX-License-Identifier: Apache-2.0
 */
#include <zephyr/kernel.h>
#include <zephyr/types.h>
#include <stddef.h>
#include <zephyr/sys/printk.h>
#include <zephyr/sys/util.h>

#include <zephyr/bluetooth/bluetooth.h>
#include <zephyr/bluetooth/hci.h>

// SEMAPHORE
K_SEM_DEFINE(acking, 0, 1);
volatile uint8_t mfg_data[] = {'D', 'I', 'S', '0', '1', 'x', 9};
static uint8_t conn_dev[] = {'R', 'E', 'M', '0', '1', 'x'};
uint8_t S_CONN_DEV = sizeof(conn_dev);
volatile struct bt_data ad[] = {
	BT_DATA(BT_DATA_MANUFACTURER_DATA, mfg_data, 14),
};

volatile struct bt_le_scan_param scan_param = {
	.type = BT_HCI_LE_SCAN_PASSIVE,
	.options = BT_LE_SCAN_OPT_NONE,
	.interval = 0x00A0,
	.window = 0x0080,
};

volatile uint8_t count = 0;
bool open_tx = false;

static void scan_cb(const bt_addr_le_t *addr, int8_t rssi, uint8_t adv_type,
					struct net_buf_simple *buf)
{
	bool read_dev = false;
	int i = 0;
	//  check for REM device
	for (i; i < buf->len; i++)
	{
		// iterate through device name
		if (buf->data[i] == conn_dev[0])
		{
			read_dev = true;
			break;
		}
	}
	if (read_dev == false)
	{
		// device is NOT a REM
		return;
	}

	char device[6];
	int k = 0;

	// Confirm device REM
	while (k < S_CONN_DEV)
	{
		if (buf->data[i] == conn_dev[k])
		{
			device[k] = buf->data[i];
			i++;
			k++;
		}
		else
		{
			read_dev = false;
			// device is not a REM
			return;
		}
	}

	// device is a REM
	if (read_dev)
	{
		count = buf->data[i];
		mfg_data[6] = count;
		//k_sem_give(&acking);
		return;
	}
	else
	{
		return;
	}

	// ACK reciept of count to REM device
}

int bluetooth_init(void)
{

	int err;

	printk("Starting Scanner/Advertiser Demo\n");

	/* Initialize the Bluetooth Subsystem */
	err = bt_enable(NULL);
	if (err)
	{
		printk("Bluetooth init failed (err %d)\n", err);
		return 0;
	}

	printk("Bluetooth initialized\n");

	err = bt_le_scan_start(&scan_param, scan_cb);
	if (err)
	{
		printk("Starting scanning failed (err %d)\n", err);
		return 0;
	}

	// while (1)
	// {
	// 	k_sem_take(&acking, K_FOREVER);

	// 	// printk("ACK REM\n");

	// 	// err = bt_le_adv_stop();
	// 	// if (err)
	// 	// {
	// 	// 	printk("Advertising failed to stop (err %d)\n", err);
	// 	// 	return 0;
	// 	// }
		
	// 	err = bt_le_adv_start(BT_LE_ADV_NCONN, ad, ARRAY_SIZE(ad),
	// 							   NULL, 0);
	// 	if (err)
	// 	{
	// 		printk("Advertising failed to start (err %d)\n", err);
	// 		return 0;
	// 	}
	// }

	return 0;
}
```
